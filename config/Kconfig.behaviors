## config/Kconfig.behaviors
```kconfig
config ZMK_BEHAVIOR_RAW_DRAG_SCROLL
    bool
    default y
    depends on DT_HAS_ZMK_BEHAVIOR_RAW_DRAG_SCROLL_ENABLED

config ZMK_AUTO_MOUSE_LAYER_TIMEOUT_MS
    int "AutoMouseLayer timeout"
    # Longer default is useful for debugging.
    default 700
    depends on RAW_HID
    help
      Time in milliseconds after the last Ploopy AutoMouseLayer notification
      before the automatically activated Mouse layer is released.
```

## config/dts/bindings/zmk,auto-mouse-layer.yaml
```yaml
description: Ploopy AutoMouseLayer configuration
compatible: "zmk,auto-mouse-layer"
properties:
  mac-base-layer:
    type: int
    required: true
  mac-mouse-layer:
    type: int
    required: true
  windows-base-layer:
    type: int
    required: true
  windows-mouse-layer:
    type: int
    required: true
```

## config/dts/bindings/zmk,mouse-activity.yaml
```yaml
description: Ploopy mouse activity layer configuration
compatible: "zmk,mouse-activity"
properties:
  mac-base-layer:
    type: int
    required: true
  mac-mouse-layer:
    type: int
    required: true
  windows-base-layer:
    type: int
    required: true
  windows-mouse-layer:
    type: int
    required: true
```

## config/west.yml
```yaml
manifest:
  remotes:
    - name: zmkfirmware
      url-base: https://github.com/zmkfirmware
    - name: magagne
      url-base: https://github.com/magagne
    - name: zzeneg
      url-base: https://github.com/zzeneg

  projects:
    - name: zmk
      remote: magagne
      revision: f0e971b0b9a67c974d377e0f6c7873ef85dad6e0
      import: app/west.yml

    - name: zmk-raw-hid
      remote: zzeneg
      revision: main

  self:
    path: config
```
